## drivers/shapertools/coltrane/Kconfig
```kconfig
menu "Shaper Tools Drivers"

source "drivers/shapertools/coltrane/mcu/Kconfig"
source "drivers/shapertools/coltrane/external/pixiepro-spread-spectrum/Kconfig"
source "drivers/shapertools/coltrane/usbh1-oc-alert/Kconfig"

endmenu
```

## drivers/shapertools/coltrane/mcu/Kconfig
```kconfig
config COLTRANE_MCU
	tristate "Coltrane MCU stack"
	select SPI_IMX
	depends on ARCH_MXC
	help
	  Say Y here if you want to enable the Coltrane MCU stack
```

## drivers/shapertools/coltrane/usbh1-oc-alert/Kconfig
```kconfig
config USBH1_OC_ALERT
    tristate "USBH1 Overcurrent GPIO Notifier"
    depends on GPIOLIB && OF
    default m
    help
      This driver logs dmesg messages when the USBH1 overcurrent GPIO
      goes low (overcurrent detected) or high (cleared). Use this if your
      USB power switch supports OC_N signaling but handles power switching
      itself and if you don't want Kernel USB system turning off USB on OC
```
